## components/esp-idf-lib__pcf8574/examples/i2c/main/Kconfig.projbuild
```kconfig
menu "Example configuration"
    config EXAMPLE_I2C_ADDR
        hex "I2C address of PCF8574"
        default 0x27

    rsource "../../../Kconfig.i2c"
endmenu
```

## main/Kconfig.projbuild
```kconfig
menu "AHT20 I2C Configuration"

    config I2C_MASTER_SDA
        int "AHT20 I2C SDA GPIO"
        default 8
        range 0 48
        help
            GPIO used for the AHT20 I2C SDA line.

    config I2C_MASTER_SCL
        int "AHT20 I2C SCL GPIO"
        default 9
        range 0 48
        help
            GPIO used for the AHT20 I2C SCL line.

endmenu
```

## sdkconfig.defaults
```kconfig
# 1. 目标芯片
CONFIG_IDF_TARGET="esp32s3"

# 2. Flash 设置（8MB）
CONFIG_ESPTOOLPY_FLASHSIZE_8MB=y
CONFIG_ESPTOOLPY_FLASHMODE_QIO=y
CONFIG_ESPTOOLPY_FLASHFREQ_80M=y

# 3. PSRAM
CONFIG_SPIRAM=y
CONFIG_SPIRAM_MODE_OCT=y
CONFIG_SPIRAM_USE_CAPS_ALLOC=y
CONFIG_SPIRAM_SPEED_80M=y
CONFIG_SPIRAM_RODATA=y

# 5. 分区表
CONFIG_PARTITION_TABLE_CUSTOM=y
CONFIG_PARTITION_TABLE_CUSTOM_FILENAME="partitions.csv"

# 6. 通用优化
CONFIG_COMPILER_OPTIMIZATION_DEBUG=y
CONFIG_ESP_DEFAULT_CPU_FREQ_MHZ_240=y
CONFIG_FREERTOS_HZ=1000
CONFIG_FREERTOS_SUPPORT_STATIC_ALLOCATION=y

# 7. 外设
CONFIG_FATFS_VOLUME_COUNT=2
CONFIG_FATFS_LFN_HEAP=y

# 8. I2C 设备库默认引脚（与 AHT20 I2C 配置一致）
CONFIG_I2CDEV_DEFAULT_SDA_PIN=8
CONFIG_I2CDEV_DEFAULT_SCL_PIN=9
CONFIG_I2CDEV_USE_LEGACY_DRIVER=y

# LVGL（按当前 lv_ui 端口所需的 Kconfig 项）
CONFIG_ESP32S3_DATA_CACHE_LINE_64B=y

CONFIG_EXAMPLE_LVGL_PORT_TASK_CORE=1
CONFIG_EXAMPLE_LVGL_PORT_AVOID_TEAR_ENABLE=y
CONFIG_EXAMPLE_LVGL_PORT_ROTATION_DEGREE=90

CONFIG_LV_COLOR_SCREEN_TRANSP=y
CONFIG_LV_MEM_CUSTOM=y
CONFIG_LV_MEMCPY_MEMSET_STD=y
CONFIG_LV_USE_LOG=y
CONFIG_LV_LOG_PRINTF=y
CONFIG_LV_USE_PERF_MONITOR=y
CONFIG_LV_ATTRIBUTE_FAST_MEM_USE_IRAM=y
CONFIG_LV_FONT_MONTSERRAT_12=y
CONFIG_LV_FONT_MONTSERRAT_16=y
CONFIG_LV_FONT_MONTSERRAT_20=y
CONFIG_LV_FONT_MONTSERRAT_24=y
CONFIG_LV_FONT_MONTSERRAT_28=y
CONFIG_LV_USE_FONT_COMPRESSED=y
CONFIG_LV_FONT_FMT_TXT_LARGE=y
CONFIG_LV_USE_IMGFONT=y
CONFIG_LV_USE_DEMO_WIDGETS=y
# 9. Wi-Fi + 网络（电子相册云端下载）
CONFIG_ESP_WIFI_STA=y
CONFIG_ESP_WIFI_SOFTAP=n
CONFIG_LWIP_DNS_SUPPORT_MDNS_QUERIES=y

# 网络配置（可通过 idf.py menuconfig 修改）
CONFIG_WIFI_SSID="1"
CONFIG_WIFI_PASSWORD="00000000a"
CONFIG_SERVER_URL="http://192.168.153.192:8765"
CONFIG_DOWNLOAD_KEY=""

# 10. I2C 旧版驱动兼容（ESP-IDF v6.0.1 中 driver/i2c.h 已弃用，但第三方库尚未完全迁移）
CONFIG_I2C_SUPPRESS_DEPRECATE_WARN=y
CONFIG_I2C_BUS_BACKWARD_CONFIG=y

# 只保留工程里实际调用的 widgets demo，避免编译无用 demo 引入额外告警/报错
# CONFIG_LV_USE_DEMO_BENCHMARK is not set
# CONFIG_LV_USE_DEMO_STRESS is not set
# CONFIG_LV_USE_DEMO_MUSIC is not set
# CONFIG_LV_DEMO_MUSIC_AUTO_PLAY is not set

# 11. ESP-SR 语音模型（WakeNet9 + MultiNet7 + VADNet1 + NSNet）
CONFIG_ESP_SR_SUPPORT_WAKENET9=y
CONFIG_ESP_SR_SUPPORT_MULTINET7=y
CONFIG_ESP_SR_SUPPORT_VADNET1=y
CONFIG_ESP_SR_SUPPORT_NSNET1=y
CONFIG_USE_WAKENET9=y
CONFIG_USE_MULTINET7=y
CONFIG_USE_VADNET1=y
CONFIG_USE_NSNET1=y

# SPIFFS 用于存放语音模型
CONFIG_SPIFFS_USE_MTIME=y

# 12. I2S 零填充（避免短帧触发 I2S 超时）
CONFIG_I2S_SUPPRESS_DEPRECATE_WARN=y
CONFIG_I2S_ISR_IRAM_SAFE=y

# 13. WebSocket
CONFIG_ESP_WEBSOCKET_CLIENT=y

# 14. 语音助手网络配置
CONFIG_VA_WS_URI="ws://192.168.153.192:8888"
CONFIG_VA_MIC_WS_PIN=6
CONFIG_VA_MIC_SCK_PIN=15
CONFIG_VA_MIC_SD_PIN=16
CONFIG_VA_SPK_BCLK_PIN=11
CONFIG_VA_SPK_LRCK_PIN=12
CONFIG_VA_SPK_DIN_PIN=13
CONFIG_VA_SPK_SD_PIN=19
```
